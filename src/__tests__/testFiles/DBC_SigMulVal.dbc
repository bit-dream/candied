VERSION ""

NS_ :

BS_:

BU_:

BO_ 2024 OBD2: 8 Vector__XXX
 SG_ S6base : 2|4@1+ (1,0) [0|0] "" Vector__XXX
 SG_ S5base : 11|8@1+ (1,0) [0|0] "" Vector__XXX
 SG_ S1_PID_0D_VehicleSpeed m13 : 31|8@0+ (1,0) [0|255] "km/h" Vector__XXX
 SG_ S1_PID_11_ThrottlePosition m17 : 31|8@0+ (0.39216,0) [0|100] "%" Vector__XXX
 SG_ SS1 m1M : 23|8@0+ (1,0) [0|255] "" Vector__XXX
 SG_ Service M : 11|4@0+ (1,0) [0|15] "" Vector__XXX

SG_MUL_VAL_ 2024 S1_PID_0D_VehicleSpeed SS1 13-13;
SG_MUL_VAL_ 2024 S1_PID_11_ThrottlePosition SS1 17-17;
SG_MUL_VAL_ 2024 SS1 Service 1-1;

BO_ 2348875518 ExtendedMultiplexMessage: 8 Vector__XXX
 SG_ S6base : 2|4@1+ (1,0) [0|0] "" Vector__XXX
 SG_ S5base : 10|4@1+ (1,0) [0|0] "" Vector__XXX
 SG_ S4base : 10|4@1+ (1,0) [0|0] "" Vector__XXX
 SG_ S6 m2 : 2|4@1+ (1,0) [0|0] "" Vector__XXX
 SG_ S5 m6 : 10|4@1+ (1,0) [0|0] "" Vector__XXX
 SG_ S4 m5 : 10|4@1+ (1,0) [0|0] "" Vector__XXX
 SG_ S3 m4 : 18|4@1+ (1,0) [0|0] "" Vector__XXX
 SG_ S2 m4 : 10|4@1+ (1,0) [0|0] "" Vector__XXX
 SG_ S1 m0M : 2|4@1+ (1,0) [0|0] "" Vector__XXX
 SG_ S0 M : 0|2@1+ (1,0) [0|0] "" Vector__XXX

BA_DEF_ BO_  "SingleFrame" INT 0 1;
BA_DEF_ SG_  "SigType" ENUM  "Default","Range","RangeSigned","ASCII","Discrete","Control","ReferencePGN","DTC","StringDelimiter","StringLength","StringLengthControl";
BA_DEF_ SG_  "GenSigEVName" STRING ;
BA_DEF_ SG_  "GenSigILSupport" ENUM  "No","Yes";
BA_DEF_ SG_  "GenSigSendType" ENUM  "Cyclic","OnWrite","OnWriteWithRepetition","OnChange","OnChangeWithRepetition","IfActive","IfActiveWithRepetition","NoSigSendType";
BA_DEF_ BO_  "GenMsgILSupport" ENUM  "No","Yes";
BA_DEF_ BU_  "NmStationAddress" INT 0 255;
BA_DEF_ BO_  "GenMsgSendType" ENUM  "cyclic","NotUsed","IfActive","NotUsed","NotUsed","NotUsed","NotUsed","NotUsed","noMsgSendType";
BA_DEF_ BO_  "GenMsgRequestable" INT 0 1;
BA_DEF_  "DBName" STRING ;
BA_DEF_  "BusType" STRING ;
BA_DEF_  "ProtocolType" STRING ;
BA_DEF_ BO_  "VFrameFormat" ENUM  "StandardCAN","ExtendedCAN","reserved","J1939PG";
BA_DEF_DEF_  "SingleFrame" 1;
BA_DEF_DEF_  "SigType" "Default";
BA_DEF_DEF_  "GenSigEVName" "Env@Nodename_@Signame";
BA_DEF_DEF_  "GenSigILSupport" "Yes";
BA_DEF_DEF_  "GenSigSendType" "NoSigSendType";
BA_DEF_DEF_  "GenMsgILSupport" "Yes";
BA_DEF_DEF_  "NmStationAddress" 254;
BA_DEF_DEF_  "GenMsgSendType" "noMsgSendType";
BA_DEF_DEF_  "GenMsgRequestable" 1;
BA_DEF_DEF_  "DBName" "";
BA_DEF_DEF_  "BusType" "CAN";
BA_DEF_DEF_  "ProtocolType" "ISO11783";
BA_DEF_DEF_  "VFrameFormat" "J1939PG";
BA_ "DBName" "ExtendedMultiplexDbc";

SG_MUL_VAL_ 2348875518 S6 S0 2-2;
SG_MUL_VAL_ 2348875518 S5 S1 6-6;
SG_MUL_VAL_ 2348875518 S4 S1 5-5;
SG_MUL_VAL_ 2348875518 S3 S1 4-4;
SG_MUL_VAL_ 2348875518 S2 S1 4-4;
SG_MUL_VAL_ 2348875518 S1 S0 0-0, 1-1;
