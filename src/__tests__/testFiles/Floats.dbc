VERSION "1.0"

NS_ :

BS_:

BU_:

BO_ 100 FloatMessage: 8 Vector___XXX
 SG_ FloatSignal1 : 0|32@1- (1,0) [0|0] "" Vector___XXXX
 SG_ FloatSignal2 : 32|32@1- (1,0) [0|0] "" Vector___XXXX

BO_ 200 DoubleMessage: 8 Vector___XXX
 SG_ DoubleSignal1 : 0|64@1- (1,0) [0|0] "" Vector___XXXX

CM_ "This DBC file demonstrates Float and Double singles" ;
SIG_VALTYPE_ 100 FloatSignal1 : 1;
SIG_VALTYPE_ 100 FloatSignal1 : 1;
SIG_VALTYPE_ 200 DoubleSignal1 : 2;
